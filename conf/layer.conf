## conf/layer.conf
```bitbake
BBPATH .= ":${LAYERDIR}"

BBFILES += "\
            ${LAYERDIR}/recipes-*/*/*.bb \
            ${LAYERDIR}/recipes-*/*/*.bbappend \
           "

BBFILE_COLLECTIONS += "metrological"
BBFILE_PATTERN_metrological := "^${LAYERDIR}/"
BBFILE_PRIORITY_metrological = "5"

LICENSE_PATH += "${LAYERDIR}/licenses"
```
